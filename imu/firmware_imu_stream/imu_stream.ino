// imu_stream.ino — QMI8658 + canonical MadgwickAHRS fusion (arduino-libraries) on the ESP32.
// Streams orientation quaternions over UART0 (CH9102 bridge -> /dev/ttyACM0)
// Format:  ms,qw,qx,qy,qz
// Board:   Waveshare ESP32-S3-LCD-1.3 (IMU on I2C: SDA=47, SCL=48)
// MadgwickAHRS.{h,cpp} vendored verbatim (plus getQuaternion accessor) from
// https://github.com/arduino-libraries/MadgwickAHRS  — same usage as SensorLib's
// official example QMI8658_MadgwickAHRS.ino (updateIMU takes dps + g).
// Build:   arduino-cli compile -b "esp32:esp32:esp32s3:FlashSize=16M,PSRAM=opi,CDCOnBoot=default"
#include <Wire.h>
#include "SensorQMI8658.hpp"
#include "MadgwickAHRS.h"

// Mount correction: sensor frame -> board-model frame (generated by
// imu_mount_calibrate.py; falls back to identity until calibrated).
#ifdef __has_include
#if __has_include("mount_quat.h")
#include "mount_quat.h"
#endif
#endif
#ifndef MOUNT_W
#define MOUNT_W 1.0f
#define MOUNT_X 0.0f
#define MOUNT_Y 0.0f
#define MOUNT_Z 0.0f
#endif

// q_out = qa (x) qb
static void quatMul(float qw, float qx, float qy, float qz,
                    float pw, float px, float py, float pz,
                    float *ow, float *ox, float *oy, float *oz) {
  *ow = qw*pw - qx*px - qy*py - qz*pz;
  *ox = qw*px + qx*pw + qy*pz - qz*py;
  *oy = qw*py - qx*pz + qy*pw + qz*px;
  *oz = qw*pz + qx*py - qy*px + qz*pw;
}

#define I2C_SDA 47
#define I2C_SCL 48
#define STREAM_RATE_HZ 100

SensorQMI8658 QMI;
Madgwick filter;
double bgxG = 0, bgyG = 0, bgzG = 0;
double bax = 0, bay = 0, baz = 0;   // accel offset (g); board must be FLAT at boot

void setup() {
  Serial.begin(115200);
  Wire.begin(I2C_SDA, I2C_SCL);

  while (!QMI.begin(Wire, QMI8658_L_SLAVE_ADDRESS, I2C_SDA, I2C_SCL)) {
    Serial.println("# ERR: QMI8658 not found");
    delay(1000);
  }

  // QST on-demand calibration (CTRL9 COD): on-chip accel+gyro offset/scale
  // correction. Needs sensors disabled + a quiet board. Removes the ~0.1 g
  // accel offsets that otherwise show up as a constant roll/pitch error.
  {
    uint16_t cgx = 0, cgy = 0, cgz = 0;
    if (QMI.calibration(&cgx, &cgy, &cgz)) {
      Serial.printf("# COD ok gains=%u,%u,%u\n", cgx, cgy, cgz);
    } else {
      Serial.println("# WARN: COD failed (keep board still, retry)");
    }
  }

  // Config mirrors SensorLib's official QMI8658_MadgwickAHRS example
  QMI.configAccelerometer(SensorQMI8658::ACC_RANGE_2G, SensorQMI8658::ACC_ODR_1000Hz, SensorQMI8658::LPF_MODE_0);
  // 1024 DPS + 1793.6 Hz ODR + LPF OFF: fast ~90 deg snaps peak ~580 dps
  // (256/512 clipped -> multi-second drag tail) and the LPF added phase lag
  // during rotation. See imu_diag.py.
  QMI.configGyroscope(SensorQMI8658::GYR_RANGE_1024DPS, SensorQMI8658::GYR_ODR_1793_6Hz, SensorQMI8658::LPF_OFF);
  QMI.enableAccelerometer();
  QMI.enableGyroscope();

  // QST gyros have a multi-second bias transient after turn-on; with the LPF
  // disabled it is NOT smoothed away, so let it settle before calibrating,
  // else the boot bias absorbs a huge error (observed: 48 deg/s yaw drift).
  delay(3000);

  // Gyro bias calibration: keep board still for ~1.5 s
  const int N = 300;
  double bgx = 0, bgy = 0, bgz = 0, sax = 0, say = 0, saz = 0;
  for (int i = 0; i < N; i++) {
    while (!QMI.getDataReady()) { delay(1); }
    float ax, ay, az, gx, gy, gz;
    QMI.getAccelerometer(ax, ay, az);
    QMI.getGyroscope(gx, gy, gz);
    bgx += gx; bgy += gy; bgz += gz;
    sax += ax; say += ay; saz += az;
    delay(5);
  }
  bgxG = bgx / N; bgyG = bgy / N; bgzG = bgz / N;
  bax = sax / N; bay = say / N; baz = saz / N - 1.0;   // flat: expect (0,0,1)
  Serial.printf("# BIAS %.6f %.6f %.6f\n", bgxG, bgyG, bgzG);
  Serial.printf("# ABIAS %.5f %.5f %.5f\n", bax, bay, baz);

  filter.begin(STREAM_RATE_HZ);   // canonical library, beta = 0.1
  Serial.println("# READY");
}

bool streamRaw = false;   // toggled live by "RAW 1|0"

void loop() {
  // Live tuning, "CMD args" on serial (forwarded by imu_server.py /ws):
  //   BETA <float>
  //   GYR  <odr> <lpf> [range]   odr: 2=1793.6Hz 3=896.8Hz; lpf: 0..3,4=OFF;
  //                              range: 0=16 1=32 2=64 3=128 4=256 5=512 6=1024 DPS
  //   RAW  <0|1>                 stream raw accel/gyro too (11-field frames)
  static String rxb;
  while (Serial.available()) {
    char c = (char)Serial.read();
    if (c == '\n' || c == '\r') {
      rxb.trim();
      const char *cmd = rxb.c_str();
      int i1, i2, i3;
      float f1;
      if (sscanf(cmd, "BETA %f", &f1) == 1) {
        filter.setBeta(f1);
        Serial.printf("# BETA %.3f\n", filter.getBeta());
      } else if (sscanf(cmd, "GYR %d %d %d", &i1, &i2, &i3) >= 2) {
        SensorQMI8658::GyroRange range = (SensorQMI8658::GyroRange)(i3 >= 0 ? i3 : 4);
        QMI.configGyroscope(range, (SensorQMI8658::GyroODR)i1, (SensorQMI8658::LpfMode)i2);
        Serial.printf("# GYR odr=%d lpf=%d range=%d\n", i1, i2, i3 >= 0 ? i3 : 4);
      } else if (sscanf(cmd, "RAW %d", &i1) == 1) {
        streamRaw = i1 != 0;
        Serial.printf("# RAW %d\n", (int)streamRaw);
      }
      rxb = "";
    } else if (rxb.length() < 32) {
      rxb += c;
    }
  }

  static uint32_t microsPrevious = micros();
  const uint32_t microsPerReading = 1000000 / STREAM_RATE_HZ;
  static uint32_t lastUpdateUs = micros();

  if (QMI.getDataReady()) {
    float ax, ay, az, gx, gy, gz;
    if (QMI.getAccelerometer(ax, ay, az) && QMI.getGyroscope(gx, gy, gz)) {
      uint32_t now = micros();
      uint32_t dt = now - lastUpdateUs;          // measured, not assumed
      lastUpdateUs = now;
      if (dt < 1000 || dt > 50000) dt = 10000;   // sanity clamp (20..1000 Hz)
      filter.begin(1000000.0f / (float)dt);      // just sets invSampleFreq

      gx -= (float)bgxG; gy -= (float)bgyG; gz -= (float)bgzG;
      ax -= (float)bax; ay -= (float)bay; az -= (float)baz;
      filter.updateIMU(gx, gy, gz, ax, ay, az);  // dps + g, per official example
      float w, x, y, z;
      filter.getQuaternion(&w, &x, &y, &z);

      if (now - microsPrevious >= microsPerReading) {
        microsPrevious = now;
        // board-frame quaternion = q_sensor (x) M   (M = R_sensor<-model)
        float bw, bx, by, bz;
        quatMul(w, x, y, z, MOUNT_W, MOUNT_X, MOUNT_Y, MOUNT_Z, &bw, &bx, &by, &bz);
        if (streamRaw) {
          Serial.printf("%lu,%.5f,%.5f,%.5f,%.4f,%.4f,%.4f,%.5f,%.5f,%.5f,%.5f\n",
                        millis(), ax, ay, az, gx, gy, gz, bw, bx, by, bz);
        } else {
          Serial.printf("%lu,%.5f,%.5f,%.5f,%.5f\n", millis(), bw, bx, by, bz);
        }
      }
    }
  }
}
